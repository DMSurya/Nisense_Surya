## NiSense-main/drivers/sensor/max302xx/Kconfig
```kconfig
# Copyright (c) 2025 AARMS Value Chain
# SPDX-License-Identifier: Apache-2.0

config MAX302XX
	bool "Maxim MAX302xx Body Sensor Driver"
	default y
	depends on DT_HAS_MAXIM_MAX30208_ENABLED
	depends on I2C
	help
	  Unified driver for Maxim MAX302xx body sensor family.
	  Auto-detects MAX30205 (simple), MAX30208 (advanced), or MAX30210 (autonomous) at runtime.
	  
	  All provide +/-0.1C accuracy for wearable health monitoring.

if MAX302XX

choice MAX302XX_TRIGGER_MODE
	prompt "Trigger mode"
	default MAX302XX_TRIGGER_GLOBAL_THREAD
	help
	  Specify the type of triggering to be used by the driver.

config MAX302XX_TRIGGER_NONE
	bool "No trigger"

config MAX302XX_TRIGGER_GLOBAL_THREAD
	bool "Use global thread"
	depends on GPIO
	help
	  When enabled, the driver uses the global system work queue.

config MAX302XX_TRIGGER_OWN_THREAD
	bool "Use own thread"
	depends on GPIO
	help
	  When enabled, the driver uses its own thread for interrupt handling.

endchoice

config MAX302XX_TRIGGER
	bool
	default y
	depends on !MAX302XX_TRIGGER_NONE

config MAX302XX_THREAD_PRIORITY
	int "Thread priority"
	depends on MAX302XX_TRIGGER_OWN_THREAD
	default 10
	help
	  Priority of thread used by the driver to handle interrupts.

config MAX302XX_THREAD_STACK_SIZE
	int "Thread stack size"
	depends on MAX302XX_TRIGGER_OWN_THREAD
	default 1024
	help
	  Stack size of thread used by the driver to handle interrupts.

config MAX302XX_INTERSAMPLE_DELAY_MS
	int "Delay (ms) between successive conversions in a FIFO-fill sequence"
	default 20
	range 0 200
	help
	  2026-09-24: on-device skin-temp readings were seen running well
	  above what genuine skin temperature should be, consistent with
	  device self-heating rather than a bad reading. In SYNC mode
	  (see MAX302XX_sample_fetch), the driver already collects
	  `fifo-samples` conversions per fetch (devicetree property,
	  currently 10 for the wearable/MAX30208), each already separated
	  by whatever MAX302XX_wait_for_ready() takes (typically 15-50ms
	  per the datasheet). This adds a SEPARATE, deliberate settle delay
	  of its own on top of that wait, inserted right after each
	  conversion completes and before the next one is triggered — so
	  the sensor spends a little more time idle between back-to-back
	  conversions instead of being driven at maximum duty cycle, which
	  is a real (if secondary) contributor to local self-heating right
	  at the sensor die during a multi-sample fetch.

	  This does NOT fix self-heating from OTHER nearby components
	  (PMIC, radio, display, PPG LEDs) bleeding into the skin sensor
	  over time — that is a PCB thermal-layout question, not something
	  firmware timing can correct, and it's why the SoC-driven skin
	  plausibility policy in the application layer
	  (APP_TEMP_SKIN_SELFHEAT_POLICY in the main Kconfig) still exists
	  as a backstop regardless of this setting.

	  Default 20ms is conservative (adds up to ~200ms total to a
	  10-sample fetch). Set to 0 to restore the previous back-to-back
	  behaviour.

config MAX302XX_LOG_RAW_SAMPLES
	bool "Log each individual raw FIFO/ADC sample and its computed temperature"
	default y
	help
	  2026-09-24: added so a raw ADC-value + computed-temperature table
	  (e.g. for a small number of readings, each showing every
	  individual FIFO sample that went into the average) can be pulled
	  straight from the device log (RTT/UART) without extra
	  instrumentation. Logs at INF level, tagged "max302xx: raw[i]=...".

	  Leave this on while collecting that data; consider turning it off
	  again afterwards on a production build to reduce log volume (each
	  fetch logs one line per FIFO sample collected, e.g. 10 lines for
	  the wearable sensor's default `fifo-samples = <10>`).

module = MAX302XX
module-str = MAX302xx temperature sensor
source "subsys/logging/Kconfig.template.log_config"

endif # MAX302XX
```

## NiSense-main/drivers/sensor/vcnl3040/Kconfig
```kconfig
# SPDX-License-Identifier: Apache-2.0
# Copyright (c) 2025 AARMS Value Chain

config VCNL3040
	bool "VCNL3040 Proximity Sensor"
	default y
	depends on DT_HAS_VISHAY_VCNL3040_ENABLED
	select I2C
	help
	  Enable driver for Vishay VCNL3040 proximity sensor.
	  
	  This sensor provides 16-bit proximity sensing with
	  integrated IR LED and photodiode, sunlight cancellation,
	  and programmable thresholds.
```

## NiSense-main/drivers/wifi/Kconfig
```kconfig
# SPDX-License-Identifier: Apache-2.0
# Wi-Fi driver configuration

menuconfig WIFI_WEXX
	bool "WExx Wi-Fi Module Driver"
	depends on SERIAL && GPIO && WIFI
	select RING_BUFFER
	select WIFI_OFFLOAD
	select NET_L2_WIFI_MGMT
	select NET_OFFLOAD
	help
	  Enable driver for WE10/WE20D Wi-Fi modules with ASCII AT command interface.
	  Integrates with Zephyr's Wi-Fi management ecosystem (NET_L2_WIFI_MGMT).
	  Supports Wi-Fi STA mode with scan, connect, and disconnect operations.

if WIFI_WEXX

config WIFI_WEXX_INIT_PRIORITY
	int "WExx driver initialization priority"
	default 80
	help
	  Driver initialization priority for WExx Wi-Fi module.

config WIFI_WEXX_RX_BUF_SIZE
	int "UART receive ring buffer size"
	default 1024
	help
	  Size of the receive ring buffer for UART communication.

config WIFI_WEXX_TX_BUF_SIZE
	int "UART transmit buffer size"
	default 512
	help
	  Maximum size of a single command. Reduced for RAM constraints.

config WIFI_WEXX_RESPONSE_TIMEOUT_MS
	int "Command response timeout in milliseconds"
	default 5000
	help
	  Timeout for waiting for a response after sending a command.

config WIFI_WEXX_CONNECT_TIMEOUT_MS
	int "Wi-Fi connection timeout in milliseconds"
	default 30000
	help
	  Timeout for Wi-Fi connection to complete.

config WIFI_WEXX_MAX_SSID_LEN
	int "Maximum SSID length"
	default 32
	help
	  Maximum length of SSID string.

config WIFI_WEXX_MAX_PASSWORD_LEN
	int "Maximum password length"
	default 64
	help
	  Maximum length of Wi-Fi password.

config WIFI_WEXX_MAX_SCAN_RESULTS
	int "Maximum number of scan results"
	default 10
	help
	  Maximum number of access points to store during scan.

config WIFI_WEXX_WORKQUEUE_STACK_SIZE
	int "Workqueue stack size"
	default 2048
	help
	  Stack size for the WExx driver workqueue.

config WIFI_WEXX_RX_THREAD_STACK_SIZE
	int "RX thread stack size"
	default 1024
	help
	  Stack size for the UART receive thread.

config WIFI_WEXX_HTTP_RESPONSE_SIZE
	int "HTTP response buffer size"
	default 512
	range 256 2048
	depends on WIFI_WEXX_HTTP
	help
	  Scratch buffer for AT-command HTTP responses (ACK JSON / OTA hex chunks).

config WIFI_WEXX_LINE_BUF_SIZE
	int "UART line parse buffer size"
	default 384
	range 128 1024
	help
	  Per-line AT response parse buffer.

config WIFI_WEXX_LOG_LEVEL
	int "Log level for WExx driver"
	default 3
	range 0 4
	help
	  Log level for the WExx Wi-Fi driver.
	  0 = Off, 1 = Error, 2 = Warning, 3 = Info, 4 = Debug

menu "Protocol Modules"

config WIFI_WEXX_HTTP
	bool "HTTP support"
	default y
	help
	  Enable HTTP GET/POST support for the WExx module.

config WIFI_WEXX_NTP
	bool "NTP time sync support"
	default y
	help
	  Enable NTP time synchronization support.

config WIFI_WEXX_MQTT
	bool "MQTT support"
	default y
	help
	  Enable MQTT client support (connect, publish, subscribe).

config WIFI_WEXX_WEBSOCKET
	bool "WebSocket support"
	default y
	help
	  Enable WebSocket client support.

config WIFI_WEXX_SOCKET
	bool "Raw socket support"
	default y
	help
	  Enable TCP/UDP/SSL socket client support.

config WIFI_WEXX_AP
	bool "AP mode support"
	default n
	help
	  Enable Access Point mode and UDP server support.

config WIFI_WEXX_OTA
	bool "OTA firmware update support"
	default n
	help
	  Enable Over-The-Air firmware update support for the WExx module.

config WIFI_WEXX_FLASH
	bool "User flash storage support"
	default n
	help
	  Enable user flash read/write support.

endmenu # Protocol Modules

endif # WIFI_WEXX
```

## NiSense-main/dts/bindings/regulator/maxim,max20360-regulator.yaml
```yaml
# Copyright (c) 2025
# SPDX-License-Identifier: Apache-2.0

description: Maxim MAX20360 PMIC Regulator Container

compatible: "maxim,max20360-regulator"

include: base.yaml

child-binding:
  include:
    - name: regulator.yaml
      property-allowlist:
        - regulator-name
        - regulator-init-microvolt
        - regulator-min-microvolt
        - regulator-max-microvolt
        - regulator-boot-on
        - regulator-always-on

  properties:
    maxim,power-cycle-on-init:
      type: boolean
      description: |
        If set, performs a clean power cycle during regulator initialization:
        1. Disable regulator (turn OFF)
        2. Wait for power-cycle-delay-ms
        3. Enable regulator (turn ON) with configured voltage
        
        This is useful for peripherals that need a hard reset cycle (e.g., sensor hubs
        that get stuck in reset state). The power cycle happens during POST_KERNEL
        initialization, before application starts.
        
        Note: Overrides regulator-boot-on behavior - regulator will be disabled first
        even if boot-on is set.
    
    maxim,power-cycle-delay-ms:
      type: int
      default: 100
      description: |
        Delay in milliseconds between disable and re-enable during power cycle.
        Default is 100ms, which is sufficient for most peripherals to fully reset.
        Minimum value should be at least 50ms to ensure proper power-down.

    maxim,source:
      type: string
      required: true
      enum:
        - "bk1"
        - "bk2"
        - "bk3"
        - "bbout"
        - "l1out"
        - "l2out"
        - "lsw1"
        - "lsw2"
        - "boost"
        - "sfout"
      description: |
        Specifies which regulator output this node controls.
        - bk1: Buck 1 (0.55-1.18V, 10mV steps)
        - bk2: Buck 2 (0.55-2.125V, 25mV steps)
        - bk3: Buck 3 (0.55-3.7V, 50mV steps)
        - bbout: Buck-Boost output (2.5-5.5V, 50mV steps)
        - l1out: LDO1 output (0.5-1.95V, 25mV steps)
        - l2out: LDO2 output (0.9-4.0V, 100mV steps)
        - lsw1: Load Switch 1 (pass-through, no voltage control)
        - lsw2: Load Switch 2 (pass-through, no voltage control)
        - boost: Boost output (5.0-20V, configurable steps)
        - sfout: Smart fixed output (3.3V or 5.0V selectable)
```

## NiSense-main/dts/bindings/sensor/glucose-sensor.yaml
```yaml
# SPDX-License-Identifier: Apache-2.0

description: |
  Non-invasive glucose measurement sensor using optical sensing
  
  This driver controls an infrared LED (1550nm) and reads glucose signal
  from a photodiode via an instrumentation amplifier chain. The system
  uses near-infrared spectroscopy (NIRS) principles to detect glucose
  concentration through tissue optical properties.
  
  Hardware architecture (see docs/sensors/GLUCOSE_ANALOG_FRONTEND.md):
  - IR LEDs SMC1550 (1550nm) + SMC1050 (1050nm) paralleled via GPIO
    -> BC847 -> SI2333CDS (single drive; mixed return, not sequenced)
  - InGaAs PIN photodiode (Hamamatsu G11193-03) -> OPA358 TIA
    (Rf = 10 MOhm, Cf ≈ 0.8 pF; EN tied to 3V3)
  - INA122UA (RG pins shorted to GND; REF = GND) -> SAADC
  - Discrete analog AFE; no register-mapped sensor IC

compatible: "glucose-sensor"

include:
  - name: base.yaml

properties:
  ir-led-gpios:
    type: phandle-array
    required: true
    description: |
      GPIO pin controlling IR LED power via transistor/MOSFET switch.
      Active high - GPIO set high enables LED illumination.
      Example: <&gpio0 24 GPIO_ACTIVE_HIGH>

  io-channels:
    type: phandle-array
    required: true
    description: |
      ADC channel for glucose signal input. Must reference an ADC channel
      node configured with appropriate gain and reference voltage.
      Example: <&adc 1> where channel 1 is configured for AIN1 (P0.03)

  num-samples:
    type: int
    default: 80
    description: |
      Number of ADC samples to capture per measurement cycle.
      Higher values improve signal-to-noise ratio but increase
      measurement time. Typical range: 20-200 samples.
      Default: 80 samples

  led-delay-ms:
    type: int
    default: 2000
    description: |
      Pre-sampling delay in milliseconds after LED activation.
      This allows LED output and tissue response to stabilize
      before capturing ADC samples. Typical range: 1000-5000ms.
      Default: 2000ms (2 seconds)

  sample-rate-hz:
    type: int
    default: 100
    description: |
      ADC sampling rate in Hz (samples per second). Used to calculate
      inter-sample delay. Maximum rate depends on ADC peripheral
      capabilities and desired signal quality.
      Default: 100 Hz (10ms per sample)

  calibration-offset-mv:
    type: int
    default: 0
    description: |
      Calibration offset in millivolts to subtract from raw ADC
      readings. This compensates for photodiode dark current and
      amplifier offset. Measured during initialization with LED off.
      Default: 0 (no offset correction)

  calibration-gain:
    type: int
    default: 1000
    description: |
      Calibration gain multiplier applied to ADC readings after
      offset correction, stored as integer (1000 = 1.0, 500 = 0.5, 2000 = 2.0).
      Used to normalize measurements to known glucose standards.
      Default: 1000 (1.0 = no gain correction)

  algorithm-intercept-constant:
    type: int
    default: 161832
    description: |
      Watch Intercept Algorithm constant stored as fixed-point (x1000).
      Example: 161832 = 161.832221420583.
      Intercept value for baseline glucose prediction in algorithm.
      Default: 161832 (empirically determined from calibration matrix)

  algorithm-outlier-k-factor:
    type: int
    default: 1750
    description: |
      K-Sigma outlier detection factor stored as fixed-point (x1000).
      Example: 1750 = 1.75.
      Controls sensitivity of outlier detection (higher = less aggressive).
      Default: 1750 (tuned for sensor noise characteristics)

  glucose-normalization-divisor:
    type: int
    default: 18
    description: |
      Divisor for normalizing glucose from mg/dL to mmol/L.
      Used in HOMA-IR insulin resistance calculations.
      Default: 18

  homa-ir-divisor:
    type: int
    default: 405
    description: |
      Standard HOMA-IR (Homeostasis Model Assessment) divisor.
      Formula: HOMA-IR = (glucose * insulin) / divisor.
      Default: 405 (standard HOMA-IR divisor per Matthews et al. 1985)

  insulin-calibration-adjustment:
    type: int
    default: 1050
    description: |
      Calibration adjustment for insulin measurements, stored as fixed-point (x1000).
      Example: 1050 = 1.05 (5% adjustment).
      Applied to fasting insulin values in HOMA-IR calculations.
      Default: 1050 (5% calibration adjustment factor)

  homa-ir-threshold-optimal:
    type: int
    default: 1000
    description: |
      Upper threshold for optimal HOMA-IR range, stored as fixed-point (x1000).
      Example: 1000 = 1.0.
      HOMA-IR below this value indicates optimal insulin sensitivity.
      Default: 1000 (standard cutoff for insulin-sensitive individuals)

  homa-ir-threshold-normal:
    type: int
    default: 2000
    description: |
      Upper threshold for normal HOMA-IR range, stored as fixed-point (x1000).
      Example: 2000 = 2.0.
      HOMA-IR between optimal and this value indicates normal insulin sensitivity.
      Default: 2000

  homa-ir-threshold-moderate:
    type: int
    default: 3000
    description: |
      Upper threshold for moderate HOMA-IR range, stored as fixed-point (x1000).
      Example: 3000 = 3.0.
      HOMA-IR between normal and this value indicates moderate insulin resistance.
      Default: 3000 (beginning of clinically significant insulin resistance)
```

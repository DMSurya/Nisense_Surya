## NiSense-main/dts/bindings/sensor/maxim,max30102-ppg.yaml
```yaml
# Copyright (c) 2025 NiSense
# SPDX-License-Identifier: Apache-2.0

description: |
  MAX30102 Pulse Oximeter Sensor (2-LED variant: Red + IR only)

  This binding is for the MAX30102, which is identical to MAX30101 except:
    - Only 2 LEDs (Red and IR) — no Green LED
    - LED3 (Green) settings are ignored
    - Slots configured for Green will be auto-disabled

  The sensor communicates over I2C at address 0x57.
  Part ID is 0x15 (same as MAX30101/MAX30105).

compatible: "maxim,max30102-ppg"

include: [sensor-device.yaml, i2c-device.yaml]

properties:
  mode:
    type: string
    default: "spo2"
    description: |
      Operating mode:
        "hr"    - Heart Rate only (Red LED, 1 channel)
        "spo2"  - SpO2 measurement (Red + IR LEDs, 2 channels)
        "multi" - Multi-LED mode (Red + IR only, Green slots ignored)
    enum:
      - "hr"
      - "spo2"
      - "multi"

  led1-pa:
    type: int
    default: 0x40
    description: |
      Red LED pulse amplitude (0x00-0xFF).
      Current = value × 0.2 mA. Default 0x40 = 12.8 mA.

  led2-pa:
    type: int
    default: 0x40
    description: |
      IR LED pulse amplitude (0x00-0xFF).
      Current = value × 0.2 mA. Default 0x40 = 12.8 mA.

  led3-pa:
    type: int
    default: 0x00
    description: |
      Green LED pulse amplitude - IGNORED on MAX30102 (no Green LED).
      Kept for DT compatibility with MAX30101.

  adc-range:
    type: int
    default: 2
    description: |
      SpO2 ADC full-scale range:
        0 = 2048 nA
        1 = 4096 nA
        2 = 8192 nA (default)
        3 = 16384 nA
    enum: [0, 1, 2, 3]

  sample-rate:
    type: int
    default: 0
    description: |
      SpO2 sample rate setting (SPO2_CFG SR[4:2]):
        0 = 50 sps
        1 = 100 sps
        2 = 200 sps
        3 = 400 sps
        4 = 800 sps
        5 = 1000 sps
        6 = 1600 sps
        7 = 3200 sps
    enum: [0, 1, 2, 3, 4, 5, 6, 7]

  pulse-width:
    type: int
    default: 3
    description: |
      LED pulse width / ADC resolution:
        0 = 69 us  / 15-bit
        1 = 118 us / 16-bit
        2 = 215 us / 17-bit
        3 = 411 us / 18-bit (default, maximum resolution)
    enum: [0, 1, 2, 3]

  smp-ave:
    type: int
    default: 0
    description: |
      Hardware sample averaging (FIFO_CFG SMP_AVE[7:5]):
        0 = 1 (no averaging)
        1 = 2 samples averaged
        2 = 4
        3 = 8
        4 = 16
        5-7 = 32
    enum: [0, 1, 2, 3, 4, 5, 6, 7]

  fifo-rollover:
    type: boolean
    description: |
      Enable FIFO rollover. When enabled, new samples overwrite oldest
      when FIFO is full instead of discarding new data.

  fifo-a-full:
    type: int
    default: 0
    description: |
      FIFO almost-full threshold (0-15).
      Number of empty FIFO slots when A_FULL interrupt triggers.
    enum: [0, 1, 2, 3, 4, 5, 6, 7, 8, 9, 10, 11, 12, 13, 14, 15]

  slot1:
    type: int
    default: 0
    description: "Multi-LED slot 1 (0=off, 1=Red, 2=IR). Note: 3=Green ignored on MAX30102."
    enum: [0, 1, 2, 3]

  slot2:
    type: int
    default: 0
    description: "Multi-LED slot 2 (0=off, 1=Red, 2=IR). Note: 3=Green ignored on MAX30102."
    enum: [0, 1, 2, 3]

  slot3:
    type: int
    default: 0
    description: "Multi-LED slot 3 - IGNORED on MAX30102 (only 2 channels)."
    enum: [0, 1, 2, 3]

  slot4:
    type: int
    default: 0
    description: "Multi-LED slot 4 - IGNORED on MAX30102 (only 2 channels)."
    enum: [0, 1, 2, 3]

  sample-rate-hz:
    type: int
    default: 50
    description: |
      Effective output sample rate in Hz (after hardware averaging).
      Used by the algorithm subsystem for timing and buffer sizing.
      Must match the hardware sample-rate + smp-ave combination.
      Common values: 25, 50, 100.
```

## NiSense-main/dts/bindings/sensor/maxim,max30105-ppg.yaml
```yaml
# Copyright (c) 2025 NiSense
# SPDX-License-Identifier: Apache-2.0

description: |
  MAX30105 Particle / Smoke Detection Sensor (3-LED variant)

  This binding is for the MAX30105, which is functionally identical to MAX30101
  with the same 3 LEDs (Red, IR, Green) and register map. The MAX30105 is
  optimized for particle/smoke detection applications but works identically
  for pulse oximetry.

  The sensor communicates over I2C at address 0x57.
  Part ID is 0x15 (same as MAX30101/MAX30102).

compatible: "maxim,max30105-ppg"

include: [sensor-device.yaml, i2c-device.yaml]

properties:
  mode:
    type: string
    default: "spo2"
    description: |
      Operating mode:
        "hr"    - Heart Rate only (Red LED, 1 channel)
        "spo2"  - SpO2 measurement (Red + IR LEDs, 2 channels)
        "multi" - Multi-LED mode (configurable slot assignments)
    enum:
      - "hr"
      - "spo2"
      - "multi"

  led1-pa:
    type: int
    default: 0x40
    description: |
      Red LED pulse amplitude (0x00-0xFF).
      Current = value × 0.2 mA. Default 0x40 = 12.8 mA.

  led2-pa:
    type: int
    default: 0x40
    description: |
      IR LED pulse amplitude (0x00-0xFF).
      Current = value × 0.2 mA. Default 0x40 = 12.8 mA.

  led3-pa:
    type: int
    default: 0x00
    description: |
      Green LED pulse amplitude (0x00-0xFF).
      Current = value × 0.2 mA. Default 0x00 = off.

  adc-range:
    type: int
    default: 2
    description: |
      SpO2 ADC full-scale range:
        0 = 2048 nA
        1 = 4096 nA
        2 = 8192 nA (default)
        3 = 16384 nA
    enum: [0, 1, 2, 3]

  sample-rate:
    type: int
    default: 0
    description: |
      SpO2 sample rate setting (SPO2_CFG SR[4:2]):
        0 = 50 sps
        1 = 100 sps
        2 = 200 sps
        3 = 400 sps
        4 = 800 sps
        5 = 1000 sps
        6 = 1600 sps
        7 = 3200 sps
    enum: [0, 1, 2, 3, 4, 5, 6, 7]

  pulse-width:
    type: int
    default: 3
    description: |
      LED pulse width / ADC resolution:
        0 = 69 us  / 15-bit
        1 = 118 us / 16-bit
        2 = 215 us / 17-bit
        3 = 411 us / 18-bit (default, maximum resolution)
    enum: [0, 1, 2, 3]

  smp-ave:
    type: int
    default: 0
    description: |
      Hardware sample averaging (FIFO_CFG SMP_AVE[7:5]):
        0 = 1 (no averaging)
        1 = 2 samples averaged
        2 = 4
        3 = 8
        4 = 16
        5-7 = 32
    enum: [0, 1, 2, 3, 4, 5, 6, 7]

  fifo-rollover:
    type: boolean
    description: |
      Enable FIFO rollover. When enabled, new samples overwrite oldest
      when FIFO is full instead of discarding new data.

  fifo-a-full:
    type: int
    default: 0
    description: |
      FIFO almost-full threshold (0-15).
      Number of empty FIFO slots when A_FULL interrupt triggers.
    enum: [0, 1, 2, 3, 4, 5, 6, 7, 8, 9, 10, 11, 12, 13, 14, 15]

  slot1:
    type: int
    default: 0
    description: "Multi-LED slot 1 (0=off, 1=Red, 2=IR, 3=Green)"
    enum: [0, 1, 2, 3]

  slot2:
    type: int
    default: 0
    description: "Multi-LED slot 2 (0=off, 1=Red, 2=IR, 3=Green)"
    enum: [0, 1, 2, 3]

  slot3:
    type: int
    default: 0
    description: "Multi-LED slot 3 (0=off, 1=Red, 2=IR, 3=Green)"
    enum: [0, 1, 2, 3]

  slot4:
    type: int
    default: 0
    description: "Multi-LED slot 4 (0=off, 1=Red, 2=IR, 3=Green)"
    enum: [0, 1, 2, 3]

  sample-rate-hz:
    type: int
    default: 50
    description: |
      Effective output sample rate in Hz (after hardware averaging).
      Used by the algorithm subsystem for timing and buffer sizing.
      Must match the hardware sample-rate + smp-ave combination.
      Common values: 25, 50, 100.
```

## NiSense-main/dts/bindings/sensor/maxim,max30208.yaml
```yaml
# Copyright (c) 2025 AARMS Value Chain
# SPDX-License-Identifier: Apache-2.0

description: Maxim MAX30208 digital temperature sensor

compatible: "maxim,max30208"

include: [sensor-device.yaml, i2c-device.yaml]

properties:
  int-gpios:
    type: phandle-array
    description: |
      Interrupt GPIO pin (active low).
      When data is ready or alarm thresholds are crossed, the INT pin
      is asserted low. Use GPIO_ACTIVE_LOW flag.

  temp-alarm-high:
    type: int
    description: |
      High temperature alarm threshold in millidegrees Celsius.
      Range: -40000 to 105000 (corresponds to -40°C to 105°C)
      Default: 40000 (40°C)

  temp-alarm-low:
    type: int
    description: |
      Low temperature alarm threshold in millidegrees Celsius.
      Range: -40000 to 105000 (corresponds to -40°C to 105°C)
      Default: 0 (0°C)

  fifo-samples:
    type: int
    default: 1
    enum:
      - 1
      - 2
      - 3
      - 4
      - 5
      - 6
      - 7
      - 8
      - 9
      - 10
      - 11
      - 12
      - 13
      - 14
      - 15
      - 16
      - 17
      - 18
      - 19
      - 20
      - 21
      - 22
      - 23
      - 24
      - 25
      - 26
      - 27
      - 28
      - 29
      - 30
      - 31
      - 32
    description: |
      Number of samples to read from FIFO for averaging (1-32).
      
      FIFO depth: 32 samples (16-bit each), roll-over mode enabled.
      
      Higher values provide:
      - Better noise reduction
      - Improved accuracy (reduced thermal noise)
      - Slower response time (more samples to accumulate)
      
      Recommended values:
      - 1: Fastest response, no averaging (default)
      - 4: Good balance for general use
      - 8: High accuracy for medical/precision applications
      - 16-32: Maximum averaging for stable measurements
      
      Note: Conversion time is ~15-50ms per sample.
      Total read time = conversion_time x fifo_samples
```

## NiSense-main/dts/bindings/sensor/maxim,ppg-algo.yaml
```yaml
# SPDX-License-Identifier: Apache-2.0

description: |
  Maxim PPG Algorithm Sensor
  
  Software-based HR and SpO2 algorithm that processes raw PPG data from
  a parent sensor (MAX86141 AFE or MAX32664 hub in RAW mode).
  
  This driver reads raw IR/RED channels from the parent sensor, runs 
  PPG signal processing algorithms, and exposes computed HR/SpO2 values
  via standard Zephyr sensor channels.
  
  Example device tree:
    ppg_sensor: ppg-algo {
        compatible = "maxim,ppg-algo";
        parent-sensor = <&max86141>;  /* or <&max32664_hub> */
        sample-rate-hz = <25>;
        hr-min-bpm = <40>;
        hr-max-bpm = <220>;
        quality-threshold = <50>;
        motion-rejection;
    };

compatible: "maxim,ppg-algo"

properties:
  parent-sensor:
    type: phandle
    required: true
    description: |
      Parent sensor that provides raw PPG data (IR, RED channels).
      Can be MAX86141 AFE (PASSTHROUGH mode) or MAX32664 hub (RAW mode).
  
  accel-sensor:
    type: phandle
    description: |
      Optional accelerometer sensor for motion rejection.
      Required for PASSTHROUGH mode if motion-rejection is enabled.
      In PASSTHROUGH mode, use LIS2DS12 accelerometer device.
      In HUB/RAW modes, accelerometer data comes from parent-sensor.
  
  measurement-type:
    type: int
    required: true
    description: |
      Fixed measurement type for this sensor instance:
        0 = SpO2 (uses IR + Red LED channels)
        1 = HR (uses Green LED channel)
      Each sensor instance is dedicated to one measurement type.
      Create separate device tree nodes for concurrent SpO2 and HR measurements.
    enum:
      - 0  # PPG_MEAS_SPO2
      - 1  # PPG_MEAS_HR
  
  sample-rate-hz:
    type: int
    default: 25
    description: |
      PPG sampling rate in Hz. Must match parent sensor configuration.
      Typical values: 25, 50, 100 Hz
  
  hr-min-bpm:
    type: int
    default: 40
    description: |
      Minimum valid heart rate in beats per minute.
      Values below this threshold are rejected.
  
  hr-max-bpm:
    type: int
    default: 220
    description: |
      Maximum valid heart rate in beats per minute.
      Values above this threshold are rejected.
  
  quality-threshold:
    type: int
    default: 50
    description: |
      Minimum signal quality percentage (0-100) for valid HR/SpO2.
      Results with quality below this threshold are marked invalid.
  
  motion-rejection:
    type: boolean
    description: |
      Enable motion artifact rejection using accelerometer data.
      Requires accelerometer support in parent sensor.
  
  sample-count:
    type: int
    default: 300
    description: |
      Number of samples to collect for each HR/SpO2 measurement.
      Typical values: 200-500 samples at 25 Hz = 8-20 seconds measurement time.
```

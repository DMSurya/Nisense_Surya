## Kconfig.diag_monitor
```
# SPDX-License-Identifier: Apache-2.0
#
# Diagnostics monitor tuning options.
# Master switch: CONFIG_APP_FEATURE_DIAG_MONITOR (Kconfig → application features).
# Zephyr overlays: conf/features/diag_monitor.conf (merged when master is y).

menu "NiSense — diagnostics (tuning)"
	depends on APP_FEATURE_DIAG_MONITOR

if APP_FEATURE_DIAG_MONITOR

config DIAG_MONITOR_INTERVAL_SEC
	int "Diagnostics monitor dump interval (seconds)"
	default 30
	range 1 3600

config DIAG_MONITOR_STACK_SIZE
	int "Diagnostics monitor thread stack size (bytes)"
	default 1536
	range 512 8192

config DIAG_MONITOR_PRIORITY
	int "Diagnostics monitor thread priority (preemptible, higher = lower prio)"
	default 14
	range 0 15

config DIAG_MONITOR_INITIAL_DELAY_SEC
	int "Delay before first dump (seconds)"
	default 10
	range 0 600
	help
	  Let the system finish init and exercise the main threads at
	  least once before the first dump so the stack high-watermark
	  is meaningful.

endif # APP_FEATURE_DIAG_MONITOR

endmenu
```

## sysbuild.conf
```
# =============================================================================
# Sysbuild Configuration - MCUboot Bootloader
# =============================================================================
# This file enables MCUboot bootloader to be built alongside the application
# when using sysbuild. Without this, CONFIG_BOOTLOADER_MCUBOOT only reserves
# partition space but doesn't build the bootloader.
#
# NOTE: Sysbuild-level configs use SB_ prefix. MCUboot-specific configs
# should go in sysbuild/mcuboot.conf (picked up automatically by sysbuild).
# =============================================================================

# Enable MCUboot bootloader build in sysbuild
SB_CONFIG_BOOTLOADER_MCUBOOT=y

# Generate board-scoped merged HEX artifacts (merged_<board_target>.hex)
SB_CONFIG_MERGED_HEX_FILES=y

# Disable deprecated Partition Manager — partition layout defined entirely in DTS overlays
# (boards/raytac_overlay/50_memory.overlayinc and 51_qspi.overlayinc)
SB_CONFIG_PARTITION_MANAGER=n

# Signing key file - must be set at sysbuild level
# Use absolute path since relative paths resolve from west workspace root
SB_CONFIG_BOOT_SIGNATURE_KEY_FILE="E:/AARMS/HCM/NiSense/mcuboot/root-rsa-2048.pem"

# Keep MCUboot image metadata inside sysbuild/bootloader configuration.
# The main application has IMG_MANAGER disabled, so syncing updateable-image
# metadata into the app produces noisy Kconfig warnings without adding value.
SB_CONFIG_MCUBOOT_APP_SYNC_UPDATEABLE_IMAGES=n

# MCUboot signature type - RSA (key length detected from .pem file)
SB_CONFIG_BOOT_SIGNATURE_TYPE_RSA=y
```

## prj.conf
```kconfig
################################################################################
# Project Configuration for MAX20360 PMIC + MAX32664 Sensor Hubs
# Target: nRF52840 (Raytac MDBT50Q-DB-40)
# Zephyr: v4.3.99 (NCS v3.3.0)
#
# This file is organized into logical sections with detailed descriptions.
# Each block is grouped by subsystem or feature for clarity and maintainability.
################################################################################
# Boot timing and banner — moved to conf/core/bootloader.conf

################################################################################
# 1. BOOTLOADER CONFIGURATION
#    - Moved to conf/core/bootloader.conf (always included — core overlay)
#    - Covers MCUboot, IMG_MANAGER=n, MCUMGR=n, PM static partitioning
################################################################################

################################################################################
# 2. MEMORY & STACK CONFIGURATION
#    - Moved to conf/core/memory.conf (always included — core overlay)
#    - Covers FPU, stack sizes, heap, and thread stack tuning
################################################################################

################################################################################
# 3. APPLICATION FEATURES
#    - High-level feature toggles (RTT logging, measurements)
#    - All APP_FEATURE_* toggles are grouped first
#    - Feature-specific customization follows in per-feature blocks
################################################################################
CONFIG_APP_FEATURE_RTT_LOG=y
CONFIG_APP_FEATURE_FAULT_DEBUG=y
CONFIG_APP_FEATURE_SHELL=n
CONFIG_APP_FEATURE_DISPLAY=y
# Fonts only: XIP TinyTTF (prod) vs compiled Montserrat (debug / low-RAM).
# CONFIG_APP_FONT_PROFILE_RESOURCE_RUNTIME=y
CONFIG_APP_FONT_PROFILE_SAFE_COMPILED=y
CONFIG_APP_FEATURE_MAX32664=y
# MAX3010x built alongside hub so runtime product_hw_detect can bind Pulse SKU
CONFIG_APP_FEATURE_MAX3010X=y
CONFIG_APP_FEATURE_PPG=y
CONFIG_APP_FEATURE_FILE_SYSTEM=n
CONFIG_APP_FEATURE_CONFIG_PERSIST=y
CONFIG_APP_FEATURE_GLUCOSE=y
# Wi-Fi hold: BLE-only sync while SoftAP/bulk path is investigated.
CONFIG_APP_FEATURE_WIFI=n
CONFIG_APP_FEATURE_BLE=y
# Shell selects USB; keep explicit =y when shell is on (documents dependency).
CONFIG_APP_FEATURE_USB=n
CONFIG_APP_FEATURE_SYSTEMVIEW=n
CONFIG_APP_FEATURE_MAX32664_UPDATE=n
CONFIG_APP_FEATURE_DIAG_MONITOR=n
CONFIG_APP_FEATURE_BLE_DFU=y

# RTT Logging Feature
# Feature-specific overrides are kept in conf/features/*.conf
# and can be applied when building with EXTRA_CONF_FILE.

# HR / SpO2 Features
# Automatically enabled based on MAX3010x sensor variant in device tree:
#   MAX30101/30102/30105: SpO2 + HR both enabled by default
# SpO2 re-enabled after RAM savings from right-sizing glucose_workq stacks
# (~6 KB freed) — measured incremental cost on top of HR: ~+3 KB flash,
# ~+1 KB RAM (extra channel buffers + UI screen).
# PPG workqueue and algorithm settings moved to conf/features/ppg.conf

# Wi-Fi Feature
# UI_SCREEN_WIFI moved to conf/features/wifi.conf

# BLE Feature
# UI_SCREEN_BLE moved to conf/features/ble.conf

# MAX32664 Firmware Update Feature

# Diagnostics Feature (master only — overlays in conf/features/diag_monitor.conf)
# Kconfig tuning: Kconfig.diag_monitor

################################################################################
# 4. CORE SUBSYSTEMS
#    - Moved to conf/core/hardware.conf (always included — core overlay)
#    - Covers I2C, GPIO, SPI, ADC, COUNTER, FLASH, PWM
################################################################################

################################################################################
# 5. FLASH & STORAGE CONFIGURATION
#    - Moved to conf/core/storage.conf (always included — core overlay)
#    - Covers NVS, SETTINGS, QSPI, Resource store, calibration
################################################################################

################################################################################
# 6. QSPI & EXTERNAL FLASH CONFIGURATION
#    - Moved to conf/core/storage.conf
################################################################################

################################################################################
# 8. FILESYSTEM CONFIGURATION
#    - Controlled by APP_FEATURE_FILE_SYSTEM in conf/features/filesystem.conf
################################################################################


################################################################################
# 9. STORAGE PARTITIONING
#    - QSPI partitions in boards/raytac_overlay/51_qspi.overlayinc
#    - Measurement data: record_store NOR partition (synced over BLE)
#    - App config + BLE settings: storage_nvs (128 KB)
################################################################################

################################################################################
# 10. DEBUG CONFIGURATION
#     - Moved to conf/core/debug.conf (UART_CONSOLE=n, CBPRINTF float support)
#     - RTT/LOG backend: conf/features/rtt_log.conf
#     - Fault diagnostics: conf/features/fault_debug.conf
#     - MAX32664 I2C debug dump: conf/features/max32664.conf
################################################################################

################################################################################
# 11. ENHANCED FAULT DEBUGGING FOR OZONE
#     - Moved to conf/features/fault_debug.conf
#     - Applied via EXTRA_CONF_FILE when enabling APP_FEATURE_FAULT_DEBUG
################################################################################

################################################################################
# 12. RTT console & buffers
#     - Controlled by APP_FEATURE_RTT_LOG in conf/features/rtt_log.conf
################################################################################

################################################################################
# 13. Compiler + thread diagnostics (Ozone / analyzer)
#     - Master: CONFIG_APP_FEATURE_DIAG_MONITOR (above)
#     - Kconfig tuning: Kconfig.diag_monitor
#     - Zephyr overlay: conf/features/diag_monitor.conf (tuning builds only)
#     - See docs/debugging/MEMORY_TUNING.md and docs/build/BUILD_STATUS.md
################################################################################

################################################################################
# 14. MAX20360 PMIC SUBSYSTEMS
#     - Moved to conf/core/pmic.conf (always included — core overlay)
#     - Covers REGULATOR, CHARGER, FUEL_GAUGE (all MAX20360)
################################################################################

################################################################################
# 15. HARDWARE DRIVERS
#     - Moved to conf/core/sensors.conf (always included — core overlay)
#     - Covers HWINFO, ADC, SENSOR, VCNL3040, MAX302XX, MCP79XX RTC
################################################################################

################################################################################
# 16. MAX32664 SENSOR HUB DRIVERS
#     - Moved to conf/features/max32664.conf
#     - Covers RAW mode, accel feeder, I2C timeout, firmware update settings
#     - Applied via EXTRA_CONF_FILE when enabling APP_FEATURE_MAX32664
################################################################################

################################################################################
# 16a. MAX3010x STANDALONE PPG SENSOR
#     - Moved to conf/features/max3010x.conf
#     - Covers MAX30101/MAX30102/MAX30105 unified driver
#     - Applied via EXTRA_CONF_FILE when enabling APP_FEATURE_MAX3010X
################################################################################

################################################################################
# 16b. PPG ALGORITHM SUBSYSTEM
#     - Moved to conf/features/ppg.conf
#     - Covers PPG_ALGO sample rate, buffer, workqueue, quality settings
#     - Applied via EXTRA_CONF_FILE when enabling APP_FEATURE_PPG
################################################################################

################################################################################
# 17. WEXX WI-FI MODULE DRIVER
#     - Moved to conf/features/wifi.conf
#     - Applied via EXTRA_CONF_FILE when enabling APP_FEATURE_WIFI
################################################################################

################################################################################
# 18. DISPLAY & LVGL GRAPHICS
#     - Moved to conf/features/display.conf
#     - Applied via EXTRA_CONF_FILE by build_project.ps1 (always included)
################################################################################

################################################################################
# 19. UI/LVGL CONFIGURATION
#     - Moved to conf/features/display.conf
#     - See display.conf for LVGL memory, fonts, touch, VDB settings,
#       UI screen selection, and startup logo
################################################################################

################################################################################
# 20. POWER MANAGEMENT
#     - DCDC is automatically enabled for nRF52840 via CONFIG_REGULATOR=y
################################################################################


################################################################################
# 21. SHELL & USB
#     - APP_FEATURE_USB  → conf/features/usb.conf (USBD + CDC drivers)
#     - APP_FEATURE_SHELL → conf/features/shell.conf (selects USB + SHELL_MINIMAL)
#     - Board DT always has CDC UART + zephyr,shell-uart (64/65 overlayinc)
#     - Toggle in prj.conf only; sticky -DCONFIG_*=y overrides =n (see
#       docs/build/BUILD_FLASH_DEPLOY.md). Production often leaves both n (~91% FLASH).
################################################################################

################################################################################
# 22. TIME CONFIGURATION
#     - Moved to conf/core/time.conf (always included — core overlay)
#     - Covers DATE_TIME, DATE_TIME_NTP=n, TIMER_RANDOM_INITIAL_STATE
################################################################################

################################################################################
# 23. SEGGER SYSTEMVIEW TRACING
#     - Feature-specific config moved to conf/features/systemview.conf
#     - Controlled via CONFIG_APP_FEATURE_SYSTEMVIEW and -EnableSystemView flag


################################################################################
# 24. UI CONFIGURATION
#     - UI screen selection and startup logo moved to conf/features/display.conf
################################################################################

################################################################################
# 25. BLE PPG STREAMING AND RTC CALIBRATION
#     - RTC_CALIBRATION covered by conf/core/sensors.conf
################################################################################
```

## mcuboot.conf
```kconfig
# =============================================================================
# MCUboot Bootloader Configuration (Root Level)
# =============================================================================
# NOTE: With sysbuild, the primary MCUboot config is in sysbuild/mcuboot/prj.conf
# This file may be used for non-sysbuild builds or as a fallback.
# =============================================================================

# CRITICAL: Allow MCUboot to boot an image without confirmed trailer
# This is ESSENTIAL for first boot after flashing via J-Link/Ozone!
CONFIG_BOOT_BOOTSTRAP=y

# Validate primary slot
CONFIG_BOOT_VALIDATE_SLOT0=y

# RTT Console - MUST MATCH prj.conf buffer sizes for seamless handoff
CONFIG_USE_SEGGER_RTT=y
CONFIG_RTT_CONSOLE=y
CONFIG_UART_CONSOLE=n
CONFIG_SEGGER_RTT_BUFFER_SIZE_UP=4096
CONFIG_SEGGER_RTT_MODE_NO_BLOCK_SKIP=y

# Logging
CONFIG_LOG=y
CONFIG_LOG_DEFAULT_LEVEL=3
CONFIG_LOG_BACKEND_RTT=y
CONFIG_LOG_BACKEND_UART=n
CONFIG_MCUBOOT_LOG_LEVEL_INF=y
CONFIG_PRINTK=y
CONFIG_CONSOLE=y

# Flash support
CONFIG_FLASH=y
CONFIG_FLASH_MAP=y
CONFIG_NORDIC_QSPI_NOR=y
CONFIG_NORDIC_QSPI_NOR_FLASH_LAYOUT_PAGE_SIZE=4096

# Size optimization
CONFIG_SIZE_OPTIMIZATIONS=y
CONFIG_BOOT_MAX_IMG_SECTORS=128
CONFIG_ASSERT=n
CONFIG_MCUBOOT_INDICATION_LED=n
CONFIG_BOOT_WATCHDOG_FEED=y
```

## boards/raytac_mdbt50q_db_40_nrf52840.overlay
```dts
/* =============================================================================
 * Board Overlay - Raytac MDBT50Q-DB-40 (nRF52840)
 * =============================================================================
 * Split into grouped include fragments under boards/raytac_overlay/.
 * Keep aliases in this main overlay only.
 * ============================================================================= */

#include <dt-bindings/i2c/i2c.h>
#include <dt-bindings/adc/nrf-adc.h>
#include <dt-bindings/gpio/gpio.h>

#include "raytac_overlay/00_cleanup.overlayinc"
#include "raytac_overlay/10_root_common.overlayinc"
#include "raytac_overlay/11_keys.overlayinc"
#include "raytac_overlay/20_i2c0.overlayinc"
#include "raytac_overlay/21_sensor_max20360.overlayinc"
#include "raytac_overlay/22_sensor_max20360_fuel_gauge.overlayinc"
#include "raytac_overlay/23_sensor_mcp7940n.overlayinc"
#include "raytac_overlay/24_sensor_ft6336.overlayinc"
#include "raytac_overlay/25_sensor_max30205.overlayinc"
#include "raytac_overlay/26_sensor_max30208.overlayinc"
#include "raytac_overlay/27_sensor_max30102.overlayinc"
#include "raytac_overlay/28_sensor_vcnl3040.overlayinc"
#include "raytac_overlay/29_sensor_max20360_adc.overlayinc"
#include "raytac_overlay/30_i2c1.overlayinc"
#include "raytac_overlay/31_sensor_max32664_hub.overlayinc"
#include "raytac_overlay/40_adc_glucose.overlayinc"
#include "raytac_overlay/41_spi2_display.overlayinc"
#include "raytac_overlay/50_memory.overlayinc"
#include "raytac_overlay/51_qspi.overlayinc"
#include "raytac_overlay/60_peripherals.overlayinc"
#include "raytac_overlay/61_spi1_disable.overlayinc"
#include "raytac_overlay/62_uart_wifi.overlayinc"
#include "raytac_overlay/63_usb.overlayinc"
#include "raytac_overlay/64_usb_cdc.overlayinc"
#include "raytac_overlay/65_shell_uart.overlayinc"

/ {
	/*
	 * Runtime product SKU (Watch vs Pulse) — not primary→secondary fallback.
	 *
	 * product_hw_detect() chooses exclusively:
	 *   Watch: MAX32664C + MAX86141 (ncs,ppg-primary / hub in HUB mode)
	 *   Pulse: MAX3010x direct (ncs,ppg-secondary) and/or MAX32664D hub
	 *
	 * Both endpoints stay in DT so one firmware image can detect either
	 * board. HUB vs RAW is compile-time (CONFIG_MAX32664_MODE_*).
	 * Both wearable + pulse glucose models stay in NOR for the same detect.
	 */
	chosen {
		/* Watch PPG endpoint (MAX86141 child; HUB mode binds hub in C) */
		ncs,ppg-primary   = &max86141_ppg;
		/* Pulse PPG endpoint (MAX3010x on I2C0, direct to nRF) */
		ncs,ppg-secondary = &max30102;
	};

	/* Device aliases for easy access (kept in main overlay) */
	aliases {
		/* Remove conflicting aliases from base DTS */
		/delete-property/ led0;
		/delete-property/ led1;
		/delete-property/ led2;
		/delete-property/ pwm-led0;
		/delete-property/ sw0;
		/delete-property/ sw1;
		/delete-property/ sw2;
		/delete-property/ sw3;
		/delete-property/ bootloader-led0;
		/delete-property/ mcuboot-button0;
		/delete-property/ mcuboot-led0;

		/* PMIC and regulators */
		pmic0 = &max20360;
		bk1 = &max20360_bk1;
		bk2 = &max20360_bk2;
		bk3 = &max20360_bk3;
		bbout = &max20360_bbout;
		l2out = &max20360_l2out;
		fuelgauge = &max20360_fuel_gauge;
		charger0 = &max20360_charger;
		pmicadc = &max20360_adc;

		/* Sensors */
		glucose0 = &glucose_sensor;
		buzzer0 = &buzzer_pwm;
		sw1 = &sw1;
		sw2 = &sw2;
		/* MAX32664 Hub */
		max32664-hub = &max32664_hub;
		accel-sensor = &lis2ds12_accel;   /* Motion rejection on hub path */
		/* Temperature sensors: Wearable (continuous) and Pulse (spot check) */
		temp-wearable = &max30208;  /* Wearable: Continuous monitoring (16-bit, FIFO, interrupt) */
		temp-pulse = &max30205;     /* Pulse: Finger spot check (13-bit, polling, OS alarm) */
		vcnl3040 = &vcnl3040;

		/* Other devices */
		rtc0 = &mcp7940n;
		display0 = &st7789v_display;

		/* Keep watchdog alias from base DTS */
		watchdog0 = &wdt0;

		/* Alias for new USBD stack */
		zephyr-udc0 = &usbd;

		/* Wi-Fi module alias */
		wifi0 = &wexx_wifi;
	};
};
```

## dts/bindings/adc/maxim,max20360-adc.yaml
```yaml
description: |
  Maxim MAX20360 internal SAR ADC.

  The MAX20360 8-bit SAR ADC lives in the "Haptic Driver and ADC Registers"
  block at I2C SlaveID 0xA0/0xA1 (7-bit 0x50) — a separate slave from the
  PMIC register map (7-bit 0x28).  Rail measurements (BAT, SYS, bucks,
  LDOs, ISET) are routed through the IVMON multiplexer in the PMIC map, so
  this node needs a phandle to the MAX20360 regulator parent which owns
  the mux and the PMIC register lock.

  Logical channel IDs are defined in drivers/adc/max20360_adc.h
  (0=BAT, 1=SYS, 2..8=rails, 9=ISET, 10=VHDIN).  All channels use
  ADC_REF_INTERNAL (5500 mV full scale, 8-bit).  ADC_GAIN_1_2/1_3/1_4
  engage the corresponding IVMON divider ratio.

compatible: "maxim,max20360-adc"

include: [adc-controller.yaml, i2c-device.yaml]

properties:
  reg:
    required: true
    description: |
      I2C address of the haptic/ADC block. Must be 0x50 (7-bit addressing),
      corresponding to SlaveID 0xA0/0xA1 in 8-bit addressing.

  maxim,pmic:
    type: phandle
    required: true
    description: |
      MAX20360 regulator parent node (compatible "maxim,max20360-regulator").
      Used for IVMON multiplexer channel selection.

  "#io-channel-cells":
    const: 1

io-channel-cells:
  - input
```

## dts/bindings/charger/maxim,max20360-charger.yaml
```yaml
# Copyright (c) 2025
# SPDX-License-Identifier: Apache-2.0

description: |
  Maxim MAX20360 PMIC battery charger (datasheet Rev 11).

  Charge voltage (ChgBatReg): 4.05 V–4.60 V in 50 mV steps (ChgCntl0[4:1]).
  Fast-charge current (IFCHG) is set by the external RISET resistor only
  (not I²C-programmable). Input current limit: ILimCntl[2:0] eight codes
  (50/90/150/200/300/400/450/1000 mA).

compatible: "maxim,max20360-charger"

include:
  - name: battery.yaml

properties:
  charge-voltage-microvolt:
    type: int
    default: 4200000
    description: |
      Battery regulation voltage (ChgBatReg), microvolts.
      Valid range: 4050000–4600000 in 50000 µV steps.

  charge-current-microamp:
    type: int
    deprecated: true
    description: |
      Deprecated — IFCHG is RISET-only. Prefer riset-ohms; get_prop reports
      derived IFCHG. This property is ignored by the driver.

  riset-ohms:
    type: int
    default: 4000
    description: |
      External RISET between ISET and GND (ohms). IFCHG ≈ 2000×1/RISET amperes
      (e.g. 4000 → 500 mA).

  input-current-limit-microamp:
    type: int
    default: 450000
    description: |
      CHGIN input current limit (ILimCntl[2:0]).
      Legal values (µA): 50000, 90000, 150000, 200000, 300000, 400000,
      450000, 1000000. Nearest code is selected.
```

## dts/bindings/counter/microchip,mcp79xx.yaml
```yaml
# Copyright (c) 2026 AARMS
# SPDX-License-Identifier: Apache-2.0

description: |
  Microchip MCP79xx family Real-Time Clock (RTC) with I2C interface
  
  This binding supports all MCP79xx variants:
  - MCP7940M: 64 bytes SRAM, Battery backup
  - MCP7940N: 64 bytes SRAM, Unique ID, Battery backup
  - MCP79400: 1Kbit EEPROM, Battery backup
  - MCP79410: 1Kbit EEPROM, Unique ID, Battery backup  
  - MCP79401: 1Kbit EEPROM, Unique ID (no battery backup)
  - MCP79402: 1Kbit EEPROM (no battery backup)
  - MCP79411: 1Kbit EEPROM, Unique ID, Supercap backup
  - MCP79412: 1Kbit EEPROM, Supercap backup
  
  All variants share the same RTC register map (0x00-0x1F) and use
  BCD encoding for time/date storage with year offset from 2000.
  
  Dual API Support:
  - RTC API (primary): Calendar-based operations using struct rtc_time
  - Counter API (available): Unix epoch timestamp (seconds since 1970-01-01)
  
  Alarms: 2 channels with match on sec/min/hr/day/month/weekday
  Calibration: ±127 ppm digital trimming in 1 ppm steps

compatible: "microchip,mcp79xx"

include: [base.yaml, i2c-device.yaml]

properties:
  int-gpios:
    type: phandle-array
    description: |
      MFP (Multi-Function Pin) GPIO connection for alarm interrupts.
      The MFP pin can be configured as active-low or active-high.
      If not connected, alarms can still be polled via get_pending_int().

  variant:
    type: string
    enum:
      - "mcp7940m"
      - "mcp7940n"
      - "mcp79400"
      - "mcp79410"
      - "mcp79401"
      - "mcp79402"
      - "mcp79411"
      - "mcp79412"
    description: |
      Specific chip variant (optional). Used for feature detection:
      - SRAM access (7940M/N only)
      - Unique ID reading (N variants)
      - EEPROM support (794xx series)
      If omitted, driver operates in RTC-only mode.
```

## dts/bindings/fuel_gauge/maxim,max20360.yaml
```yaml
description: |
  Maxim MAX20360 fuel gauge (ModelGauge m5). Register map matches MAX17260
  Table 17 (MAX20360 datasheet “MAX17620” is a typo). I²C 0x36 (7-bit).

compatible: "maxim,max20360-fuel-gauge"

include:
  - name: i2c-device.yaml
  - name: fuel-gauge.yaml

properties:
  reg:
    required: true
    description: |
      I2C address of the fuel gauge (7-bit 0x36).

  design-capacity-mah:
    type: int
    description: |
      Pack design capacity in mAh (DesignCap). Programmed on POR / mismatch.

  design-voltage-millivolt:
    type: int
    default: 3700
    description: |
      Nominal design voltage in mV for FUEL_GAUGE_DESIGN_VOLTAGE.

  rsense-milliohms:
    type: int
    default: 10
    description: |
      Sense resistor between CSPH–CSN in milliohms (board: 10 mΩ / 0.01 Ω).
      Current LSB = 1.5625 µV / RSENSE; capacity LSB = 5.0 µVh / RSENSE.
```

## dts/bindings/gpio/hcm,gpio-button.yaml
```yaml
# Copyright (c) 2026 NiSense Contributors
# SPDX-License-Identifier: Apache-2.0
#
# GPIO pin definition for app-owned buttons (hw_button.c).
# No Zephyr driver binds to this compatible — avoids conflict with INPUT/gpio-keys.

description: HCM board GPIO button pin (application-owned, no kernel driver)

compatible: "hcm,gpio-button"

include: base.yaml

properties:
  label:
    type: string
    description: Human-readable button name

  gpios:
    type: phandle-array
    required: true
    description: Active-low switch input with pull-up (GPIO_PULL_UP | GPIO_ACTIVE_LOW)
```

## dts/bindings/mfd/maxim,max20360.yaml
```yaml
# Copyright (c) 2025
# SPDX-License-Identifier: Apache-2.0

description: Maxim MAX20360 PMIC

compatible: "maxim,max20360"

include: i2c-device.yaml

properties:
  reg:
    required: true

  interrupt-gpios:
    type: phandle-array
    description: |
      GPIO pin for PMIC interrupt (active low)

  mpc-gpios:
    type: phandle-array
    description: |
      GPIO pins for mode control (MPC0, MPC1, MPC2)

  ivmon-gpios:
    type: phandle-array
    description: |
      GPIO pin for IVMON (current monitoring) analog output. This pin outputs
      an analog voltage proportional to the monitored current. Typically connected
      to an ADC input for current measurement.

  maxim,variant:
    type: string
    required: false
    description: |
      Override variant detection. If not specified, variant is auto-detected
      from default register values. Valid values:
      - "ev-kit"
      - "ev-kit-harvester"
      - "max20360a"
      - "max20360b"
      - "max20360c"
      - "max20360f"
      - "max20360g"
      - "max20360i"
      - "max20360j"
      - "max20360k"
      - "max20360l"
      - "max20360m"
      - "max20360o"
      - "max20360p"
```

## src/main.c
```c
#include <zephyr/kernel.h>
#include <zephyr/drivers/hwinfo.h>
#include <zephyr/logging/log.h>
#if defined(CONFIG_APP_FEATURE_DIAG_MONITOR)
#include <zephyr/debug/thread_analyzer.h>
#endif
#include <zephyr/sys/reboot.h>
#include <lvgl.h>
#include "power.h"
#include "rgb.h"
#include "led_status.h"
#include "power_mgr.h"

#include "ui.h"
#include "ui_buttons.h"
#include "ui_common.h"
#include "device_info_ui.h"
#if defined(CONFIG_UI_SCREEN_HOME_INFO)
#include "home_info_ui.h"
#endif
#include "home_last_results.h"
#include "rtc.h"
#include "glucose.h"
#include "nor_qspi_busy.h"
#include "buzzer.h"
#include "ppg.h"
#include "i2c_probe.h"
#include "config_manager.h"
#include "resource.h"
#include "resource.h"
#include "record_store.h"
#if defined(CONFIG_SETTINGS)
#include <zephyr/settings/settings.h>
#endif
#include "resource_fonts.h"
#include "ui_theme.h"
#include "resource_icons.h"
#include "temp.h"
#include "health_sched.h"
#include "ui_agent.h"
#if defined(CONFIG_CALIBRATION)
#include "calibration.h"
#endif
#include "product_hw_variant.h"
#if defined(CONFIG_GLUCOSE_MATRICES_FROM_XIP)
#include "glucose_model_xip.h"
#endif

#include "resource_logo.h"
#include "diag_monitor.h"
#include "ram_budget.h"
#include <zephyr/drivers/flash.h>
#include <zephyr/drivers/flash/nrf_qspi_nor.h>
#include <zephyr/drivers/regulator.h>
#include <zephyr/drivers/fuel_gauge.h>
#include <zephyr/drivers/charger.h>
#include <zephyr/devicetree.h>
#include <zephyr/version.h>
#include "git_version.h"
#if defined(CONFIG_MCUBOOT_IMG_MANAGER)
#include <zephyr/dfu/mcuboot.h>
#endif
#include "ota_progress_ui.h"
#include <lvgl.h>

#if defined(CONFIG_PPG_ALGO)
#include <zephyr/subsys/ppg_algo/ppg_algo.h>
#endif

/* MAX32664 sensor ecosystem API */
#include <zephyr/drivers/sensor.h>
#include <zephyr/drivers/sensor/max32664.h>

#ifdef CONFIG_APP_FEATURE_WIFI
#include <zephyr/net/net_if.h>
#include <zephyr/net/wifi_mgmt.h>
#include <zephyr/drivers/wifi/wexx.h>
#endif

#ifdef CONFIG_APP_FEATURE_CLOUD_TELEMETRY
#include "cloud_telemetry.h"
#endif

#ifdef CONFIG_APP_FEATURE_BLE
#include "ble.h"
#endif

LOG_MODULE_REGISTER(main, LOG_LEVEL_DBG);

/**
 * @brief Custom fatal error handler for enhanced stack overflow diagnostics
 * 
 * Called before the default Zephyr fatal error handler when CONFIG_MPU_STACK_GUARD
 * detects a stack overflow. Provides detailed thread and stack information
 * to aid in debugging.
 */
#if defined(CONFIG_MPU_STACK_GUARD)
void k_sys_fatal_error_handler(unsigned int reason, const struct arch_esf *esf)
{
	ARG_UNUSED(esf);

	/* Use printk (not LOG) - this must work even before LOG backend init */
	printk("=== FATAL ERROR reason=0x%x ===\n", reason);

	if (reason == K_ERR_STACK_CHK_FAIL) {
		printk("*** STACK OVERFLOW DETECTED ***\n");
	}

	/* Print current thread info */
	struct k_thread *current_thread = k_current_get();
	printk("Faulting thread: %p\n", (void *)current_thread);

	/* Also try LOG in case backend is up */
	LOG_ERR("=== FATAL ERROR DETECTED === reason=0x%x", reason);

	/* HALT - do NOT return. Returning would let the default handler call
	 * sys_reboot(), hiding the crash state. Halt here so J-Link can
	 * inspect the PC/LR/fault registers. */
	printk("HALTING - connect J-Link to inspect crash state\n");
	for (;;) {
		/* Keep core clocks active for more reliable SWD/JTAG attach after faults. */
		k_busy_wait(1000);
	}
}
#endif

/* Build time macros */
#define BUILD_DATE __DATE__
#define BUILD_TIME __TIME__

/* Hardware Info Example - Read Nordic Device ID */
static void read_device_info(void)
{
	uint8_t dev_id[16];
	int ret;
	size_t length = sizeof(dev_id);

	LOG_INF("=== Firmware Information ===");

	/* Print memory layout for debugging */
	extern char __bss_start[];
	extern char __bss_end[];
	extern char _image_ram_start[];
	extern char __ramfunc_start[];
	
	uint32_t ram_start = (uint32_t)_image_ram_start;
	uint32_t bss_start = (uint32_t)__bss_start;
	uint32_t bss_end = (uint32_t)__bss_end;
	uint32_t ram_func = (uint32_t)__ramfunc_start;
	
	uint32_t bss_size = bss_end - bss_start;
	uint32_t used_ram = bss_end - ram_start;
	
	LOG_DBG("Memory Layout:");
	LOG_DBG("  RAM Start:     0x%08x", ram_start);
	LOG_DBG("  BSS Start:     0x%08x", bss_start);
	LOG_DBG("  BSS End:       0x%08x", bss_end);
	LOG_DBG("  RAM Func:      0x%08x", ram_func);
	LOG_DBG("Memory Usage:");
	LOG_DBG("  BSS Size:      %u bytes", bss_size);
	LOG_DBG("  Used RAM:      %u bytes", used_ram);
	
	LOG_INF("=== End Firmware Information ===");

	LOG_INF("=== Hardware Information ===");

	ret = hwinfo_get_device_id(dev_id, length);
	if (ret < 0) {
		LOG_ERR("Failed to read device ID: %d", ret);
		return;
	}

	LOG_INF("Device ID length: %d bytes", ret);
	LOG_HEXDUMP_INF(dev_id, ret, "Device ID:");

	/* Display as hex string for easy reading */
	char hex_string[33] = {0}; /* 16 bytes * 2 + null terminator */
	for (int i = 0; i < ret && i < 16; i++) {
		snprintf(&hex_string[i*2], 3, "%02x", dev_id[i]);
	}
	LOG_INF("Device ID (hex): %s", hex_string);

	LOG_INF("Product SKU: %s", product_hw_variant_name(product_hw_detect()));
#if DT_HAS_ALIAS(max32664_hub)
	{
		const struct device *hub = DEVICE_DT_GET_OR_NULL(DT_ALIAS(max32664_hub));

		if (hub != NULL && device_is_ready(hub)) {
			LOG_INF("MAX32664 hub variant: %d",
				(int)max32664_get_variant(hub));
		}
	}
#endif

	/* Get reset cause */
	uint32_t reset_cause;
	ret = hwinfo_get_reset_cause(&reset_cause);
	if (ret == 0) {
		LOG_INF("Reset cause: 0x%08x", reset_cause);
	} else {
		LOG_WRN("Failed to read reset cause: %d", ret);
	}

	LOG_INF("=== End Hardware Information ===");
}


int main(void)
{
	/* DIAGNOSTIC: First output - if this prints, main() is running.
	 * Uses printk (not LOG) so it works before LOG backend init. */
	printk("=== APP MAIN START ===\n");

	/* Power first — I2C1 / hub need Buck2 before product_hw_detect. */
	LOG_INF("Initializing power rails via MAX20360...");
	if (power_init() != 0) {
		LOG_ERR("Power initialization failed — halting");
		return -EIO;
	}
	LOG_INF("Power rails enabled — all regulators configured");

	/* Product SKU (Watch/Pulse) — cached for PPG, glucose, BLE name. */
	(void)product_hw_detect();

	read_device_info();

	LOG_INF("========================================");
	LOG_INF("Build: %s %s", BUILD_DATE, BUILD_TIME);
	LOG_INF("========================================");

	LOG_INF("=== Module Versions ===");
	LOG_INF("Firmware:    %s (%s)", FW_VERSION_STRING, GIT_VERSION_STRING);
	LOG_INF("Git:         %s", GIT_HASH_FULL);
	LOG_INF("Zephyr:      %s", KERNEL_VERSION_STRING);
	LOG_INF("LVGL:        %d.%d.%d", LVGL_VERSION_MAJOR, LVGL_VERSION_MINOR, LVGL_VERSION_PATCH);
#if defined(CONFIG_PPG_ALGO)
	LOG_INF("PPG Algo:    %s", ppg_algo_version());
#endif
	LOG_INF("=== End Module Versions ===");

	LOG_INF("Initializing RTC (early init for timestamp sync)...");
	if (rtc_init() != 0) {
		LOG_ERR("RTC init failed (continuing with uptime timestamps)");
	} else {
		LOG_INF("RTC initialized - timestamps now synced with RTC");
	}

	LOG_INF("Probing I2C buses for connected devices...");
	i2c_probe_all_buses();

#if defined(CONFIG_RESOURCE)
	const struct device *ext_flash = DEVICE_DT_GET(DT_NODELABEL(mx25r64));
	if (device_is_ready(ext_flash)) {
		LOG_INF("Enabling XIP mmap for external flash...");
		nrf_qspi_nor_xip_enable(ext_flash, true);
		LOG_INF("XIP mmap enabled @ 0x12000000");
	} else {
		LOG_ERR("External flash not ready — Resource/Model unavailable");
	}

	LOG_INF("Verifying Resource store (UI fonts/logos/icons)...");
	int res_ret = resource_init();
	if (res_ret != 0) {
		LOG_WRN("Resource init failed: %d (UI may degrade)", res_ret);
	}
	resource_print_info();
	(void)resource_validate_all();

	resource_logo_init();
	resource_icons_init();
#endif

#if defined(CONFIG_GLUCOSE_MATRICES_FROM_XIP)
	LOG_INF("Verifying Model store (clinical pack CRC + SKU entry)...");
	int model_ret = model_store_boot_verify();
	if (model_ret != 0) {
		LOG_ERR("Model store verify failed: %d", model_ret);
	}
#endif

#if defined(CONFIG_CALIBRATION) && defined(CONFIG_RESOURCE)
	LOG_INF("Loading factory calibration...");
	int calib_ret = calibration_init();
	if (calib_ret != 0) {
		LOG_WRN("Factory calibration unavailable: %d (partition empty or invalid)",
			calib_ret);
	}
	calibration_log_apply_summary();
#endif

	LOG_INF("Initializing LED status manager...");
	if (led_status_init() != 0) {
		LOG_ERR("LED status init failed");
		return -EIO;
	}

	LOG_INF("Initializing buzzer PWM...");
	if (buzzer_init() != 0) {
		LOG_ERR("Buzzer init failed (continuing without buzzer)");
	}

#if defined(CONFIG_APP_FEATURE_DISPLAY)
	LOG_INF("Initializing hardware buttons (SW1/SW2 GPIO)...");
	if (ui_buttons_gpio_early_init() != 0) {
		LOG_WRN("Hardware button GPIO init failed (continuing)");
	}
#endif

	LOG_INF("Initializing UI via st7789v/ft6336/lvgl...");
	if (ui_init() != 0) {
		LOG_ERR("UI init failed");
		return -EIO;
	}

	ram_budget_log_linker_tail();
#if defined(CONFIG_UI_SCREEN_DEVICE_INFO)
	if (device_info_ui_init() != 0) {
		LOG_WRN("Device Info event hook init failed");
	}
#endif
	/* Force one initial refresh before any potentially slow storage work so the
	 * first screen becomes visible even if FAT mount/format takes a while. */
	lv_timer_handler();

#if defined(CONFIG_UI_SCREEN_DEVICE_INFO)
	device_info_ui_on_fonts_ready();
#if defined(CONFIG_UI_SCREEN_HOME_INFO)
	home_info_ui_on_fonts_ready();
#endif
	lv_timer_handler();
#endif

	/* Settings NVS backend must be up before record_store meta / config_manager
	 * call settings_save_one(); without this those saves return -ENOENT (-2). */
#if defined(CONFIG_SETTINGS)
	{
		int settings_ret = settings_subsys_init();

		if (settings_ret != 0) {
			LOG_ERR("settings_subsys_init failed: %d", settings_ret);
		} else {
			LOG_INF("Settings subsystem ready (NVS)");
		}
	}
#endif

	/* Structured NOR record store (primary measurement persistence). */
	LOG_INF("Initializing NOR record store...");
	if (record_store_init() != 0) {
		LOG_ERR("Record store init failed (measurements will not persist)");
	}

	home_last_results_load();
#if defined(CONFIG_UI_SCREEN_DEVICE_INFO)
	device_info_ui_update_screen();
	lv_timer_handler();
#endif

	/* Initialize config manager (NVS / settings) */
	LOG_INF("Initializing configuration manager...");
	if (config_manager_init() != 0) {
		LOG_WRN("Config manager init failed (using defaults)");
	} else {
		LOG_INF("Config loaded");
#ifdef CONFIG_APP_FEATURE_WIFI
		const struct config_wifi *wifi_cfg = config_get_wifi();
		LOG_INF("Config loaded - Wi-Fi SSID: %s, enabled: %s",
			wifi_cfg->ssid, wifi_cfg->enabled ? "yes" : "no");
#endif
	}

	if (power_mgr_init() != 0) {
		LOG_WRN("Power manager init failed");
	}

#ifdef CONFIG_APP_FEATURE_WIFI
	/* Initialize Wi-Fi and connect using config */
	LOG_INF("Initializing Wi-Fi module...");
	const struct device *wifi_dev = DEVICE_DT_GET_OR_NULL(DT_ALIAS(wifi0));
	if (wifi_dev && device_is_ready(wifi_dev)) {
		const struct config_wifi *wifi_cfg = config_get_wifi();
		if (wifi_cfg->enabled && wifi_cfg->ssid[0] != '\0') {
			LOG_INF("Connecting to Wi-Fi: %s", wifi_cfg->ssid);
			
			/* Use standard Zephyr Wi-Fi management API */
			struct net_if *iface = net_if_lookup_by_dev(wifi_dev);
			if (!iface) {
				LOG_ERR("Network interface not found");
			} else {
				struct wifi_connect_req_params params = {
					.ssid = (uint8_t *)wifi_cfg->ssid,
					.ssid_length = strlen(wifi_cfg->ssid),
					.psk = (uint8_t *)wifi_cfg->password,
					.psk_length = strlen(wifi_cfg->password),
					.security = (wifi_cfg->password[0] == '\0') ? 
						    WIFI_SECURITY_TYPE_NONE : WIFI_SECURITY_TYPE_PSK,
					.channel = WIFI_CHANNEL_ANY,
					.timeout = SYS_FOREVER_MS
				};
				
				int ret = net_mgmt(NET_REQUEST_WIFI_CONNECT, iface, 
						   &params, sizeof(params));
				if (ret == 0) {
					LOG_INF("Wi-Fi connection initiated");
				} else {
					LOG_WRN("Wi-Fi connection request failed: %d", ret);
				}
			}
		}
	} else {
		LOG_WRN("Wi-Fi device not ready");
	}

#ifdef CONFIG_APP_FEATURE_CLOUD_TELEMETRY
	if (cloud_telemetry_init() != 0) {
		LOG_WRN("Cloud telemetry init failed");
	}
#endif
#endif

#if defined(CONFIG_APP_FEATURE_PPG)
	LOG_INF("Initializing PPG measurement system...");
	if (ppg_init() != 0) {
		LOG_ERR("PPG init failed (non-fatal)");
	}
#endif

#if defined(CONFIG_GLUCOSE_SENSOR)
	LOG_INF("Initializing glucose sensor...");
	if (glucose_init() != 0) {
		LOG_ERR("Glucose sensor init failed");
	}
#endif

#if defined(CONFIG_APP_TEMP_MONITOR)
	LOG_INF("Initializing temperature monitor...");
	if (temp_init() != 0) {
		LOG_WRN("Temperature monitor init failed (continuing without)");
	}
#endif

#if defined(CONFIG_APP_HEALTH_SCHED)
	LOG_INF("Initializing health measurement scheduler...");
	if (health_sched_init() != 0) {
		LOG_WRN("Health scheduler init failed (continuing without auto cycles)");
	}
#endif

#if defined(CONFIG_APP_UI_AGENT)
	LOG_INF("Initializing agentic UI presenter...");
	if (ui_agent_init() != 0) {
		LOG_WRN("UI agent init failed (continuing without slideshow)");
	}
#endif

#ifdef CONFIG_APP_FEATURE_BLE
	/* BLE init may write config.json — FatFS must already be mounted. */
	if (app_ble_init() != 0) {
		LOG_ERR("BLE init failed (continuing without BLE)");
	}
	ota_progress_smp_hooks_init();
#endif

	/* Dump stack usage after initialization only when the diagnostics
	 * feature owns runtime monitoring. Keeping THREAD_ANALYZER enabled
	 * separately still helps the fatal handler without spamming boot logs. */
#if defined(CONFIG_APP_FEATURE_DIAG_MONITOR) && defined(CONFIG_THREAD_ANALYZER)
	LOG_INF("=== Stack usage after init ===");
	thread_analyzer_print(0);
#endif
#ifdef CONFIG_APP_FEATURE_DIAG_MONITOR
	/* Force one immediate dump so we have a baseline before the first
	 * interval elapses; diag_monitor thread will then pick up the cadence. */
	diag_monitor_dump_now();
#endif

#if defined(CONFIG_MCUBOOT_IMG_MANAGER)
	/* Confirm this image now that boot-time initialization has fully
	 * succeeded. MCUboot runs in swap-with-revert mode and the companion app
	 * uploads OTA images as a *test* swap (confirm=false), so without this
	 * call the bootloader reverts to the previous image on the next reset —
	 * making every successful BLE DFU silently disappear. Confirming here
	 * keeps the safety net intact: if an upgraded image faults before
	 * reaching this point, MCUboot still reverts automatically. */
	if (!boot_is_img_confirmed()) {
		int confirm_err = boot_write_img_confirmed();
		if (confirm_err) {
			LOG_ERR("MCUboot image confirm failed: %d", confirm_err);
		} else {
			LOG_INF("MCUboot image confirmed — OTA update is now permanent");
		}
	}
#endif

	bool display_was_asleep = false;

	while (1) {
#ifdef CONFIG_APP_FEATURE_BLE
		app_ble_tick();
#endif
		power_mgr_tick();

		/* Pause LVGL while the panel is asleep, or briefly while a QSPI
		 * program/erase (record store / model update) owns the NOR die —
		 * XIP fonts/icons share the same die, so concurrent access would
		 * garble reads.
		 */
		bool display_asleep = power_mgr_display_asleep();

		/* On wake, re-prime the XIP mapping (exit DPD) before the first
		 * draw so fonts/icons are not read from a sleeping flash. */
		if (display_was_asleep && !display_asleep) {
			resource_wake();
		}
		display_was_asleep = display_asleep;

		if (!display_asleep && !nor_qspi_busy()) {
			/* Update UI first to batch all changes, then process LVGL
			 * timers/refresh so all UI changes complete before refresh.
			 */
			ui_update();
			lv_timer_handler();
		}
		/* 20 ms: less LVGL stack pressure and sys_work_q congestion. */
		k_msleep(20);
	}

	return 0;
}
```

## include/app_data.h
```c
/**
 * @file app_data.h
 * @brief App-owned QSPI region (hub firmware blobs, etc.)
 *
 * Partition label "app" @ 0x726000, size 0xDA000 (~872 KB) — enough for
 * MAX32664 .msbl (~300 KB) with headroom. See 51_qspi.overlayinc /
 * PARTITION_LAYOUT.md. Records take a rounded 4 MB ahead of this region.
 */

#ifndef APP_DATA_H_
#define APP_DATA_H_

#define APP_DATA_XIP_BASE           0x12000000U
#define APP_DATA_PARTITION_OFFSET   0x726000U
#define APP_DATA_PARTITION_SIZE     0xDA000U   /* ~872 KB */
#define APP_DATA_RESOURCE_MMAP_ADDR \
	(APP_DATA_XIP_BASE + APP_DATA_PARTITION_OFFSET)

#endif /* APP_DATA_H_ */
```

## include/ble_model_transfer.h
```c
/* =============================================================================
 * BLE Glucose Model Transfer Service
 * =============================================================================
 * Custom GATT service (UUID base ...def3) for over-the-air update of the
 * glucose elimination-matrix model into the secondary A/B slot, with CRC and
 * optional Ed25519 signature verification before the active slot is flipped.
 *
 * Service:  12345678-1234-5678-1234-56789abcdef3
 *   f301 Control (Write, encrypted)   BEGIN / COMMIT / ABORT
 *   f302 Data    (Write, encrypted)   raw image chunks (appended)
 *   f303 Status  (Read/Notify)        struct ble_model_status
 *
 * Flow: BEGIN(total,version,variant) -> erase *inactive* slot -> stream chunks to
 * f302 -> COMMIT(signature) -> validate CRC + ota_compat + signature -> flip
 * active slot -> re-init algorithm. ABORT resets state at any time.
 * ============================================================================= */

#ifndef BLE_MODEL_TRANSFER_H
#define BLE_MODEL_TRANSFER_H

#include <stdint.h>

#ifdef __cplusplus
extern "C" {
#endif

/** Control characteristic command bytes (first byte of a write to f301). */
#define BLE_MODEL_CMD_BEGIN   0x01U
#define BLE_MODEL_CMD_COMMIT  0x02U
#define BLE_MODEL_CMD_ABORT   0x03U

/** Transfer state (reported in ble_model_status.state). */
enum ble_model_state {
	BLE_MODEL_STATE_IDLE = 0,
	BLE_MODEL_STATE_ERASING,
	BLE_MODEL_STATE_RECEIVING,
	BLE_MODEL_STATE_READY,      /* all bytes received, awaiting COMMIT */
	BLE_MODEL_STATE_COMMITTED,
	BLE_MODEL_STATE_ERROR,
};

/** Status characteristic payload (f303, Read/Notify). */
struct ble_model_status {
	uint8_t  state;          /* enum ble_model_state */
	int8_t   error;          /* 0 ok, negative on failure */
	uint32_t received;       /* bytes written to secondary slot */
	uint32_t total;          /* expected total bytes */
	uint32_t active_version; /* model_version of the active slot */
	uint8_t  active_slot;    /* GLUCOSE_MODEL_SLOT_* currently active */
} __packed;

/** Reset transfer state (called on disconnect). */
void ble_model_transfer_reset(void);

#ifdef __cplusplus
}
#endif

#endif /* BLE_MODEL_TRANSFER_H */
```

## include/ble_record_sync.h
```c
/* =============================================================================
 * BLE Record Sync Service
 * =============================================================================
 * Device → phone bulk pull of the NOR record_store (summaries ± raw chunks).
 *
 * Service:  12345678-1234-5678-1234-56789abcdef4
 *   f401 Control (Write, encrypted)   START / ACK / ABORT
 *   f402 Data    (Notify)             framed records (MTU-fragmented)
 *   f403 Status  (Read/Notify)        struct ble_record_sync_status
 *
 * Flow: START(after_id, mode) → Data notify frames → ACK(up_to_id[, mode]).
 * ACK wire: [cmd=0x02][up_to:u32 LE][mode:u8?] — 6 bytes preferred; legacy
 * 5-byte ACK is treated as FULL reclaim. SUMMARY ACK updates watermark only
 * (never reclaims raw); FULL ACK advances the ring tail.
 * ============================================================================= */

#ifndef BLE_RECORD_SYNC_H
#define BLE_RECORD_SYNC_H

#include <stdint.h>
#include <zephyr/toolchain.h>

#ifdef __cplusplus
extern "C" {
#endif

#define BLE_REC_CMD_START  0x01U
#define BLE_REC_CMD_ACK    0x02U
#define BLE_REC_CMD_ABORT  0x03U

#define BLE_REC_MODE_SUMMARY_ONLY 0x01U
#define BLE_REC_MODE_FULL         0x02U

enum ble_record_sync_state {
	BLE_REC_STATE_IDLE = 0,
	BLE_REC_STATE_SENDING,
	BLE_REC_STATE_DONE,
	BLE_REC_STATE_ERROR,
};

/** Status characteristic payload (f403). */
struct ble_record_sync_status {
	uint8_t  state;       /* enum ble_record_sync_state */
	int8_t   error;       /* 0 ok, negative on failure */
	uint32_t pending;     /* records still unsynced */
	uint32_t cursor_id;   /* last record_id sent (or after_id at start) */
	uint32_t sent_count;  /* records notified in this session */
} __packed;

/**
 * @brief Packed logical record frame (before MTU fragmentation).
 *
 * Wire v2: record_id:u32 | type:u16 | parent_id:u32 | measurement_id:u32 |
 *          payload_len:u16 | payload[]
 */
#define BLE_REC_FRAME_HDR_SIZE 16U

/** Fragment preamble on each Data notify: flags:u8 | offset:u16 | total:u16 */
#define BLE_REC_FRAG_HDR_SIZE  5U
#define BLE_REC_FRAG_MORE      0x01U

void ble_record_sync_reset(void);

#ifdef __cplusplus
}
#endif

#endif /* BLE_RECORD_SYNC_H */
```

## include/ble_resource_transfer.h
```c
/* =============================================================================
 * BLE Resources Transfer Service
 * =============================================================================
 * Custom GATT service (UUID base ...def5) for over-the-air update of LVGL
 * fonts/icons/logos into the inactive resource A/B slot.
 *
 * Service:  12345678-1234-5678-1234-56789abcdef5
 *   f501 Control (Write, encrypted)   BEGIN / COMMIT / ABORT
 *   f502 Data    (Write, encrypted)   raw image chunks
 *   f503 Status  (Read/Notify)        struct ble_resource_status
 *
 * Flow: BEGIN(total) -> erase inactive slot -> stream -> COMMIT -> validate
 * magic/CRC/ota_compat -> flip active slot (NVS).
 * ============================================================================= */

#ifndef BLE_RESOURCE_TRANSFER_H
#define BLE_RESOURCE_TRANSFER_H

#include <stdint.h>

#ifdef __cplusplus
extern "C" {
#endif

#define BLE_RESOURCE_CMD_BEGIN   0x01U
#define BLE_RESOURCE_CMD_COMMIT  0x02U
#define BLE_RESOURCE_CMD_ABORT   0x03U

enum ble_resource_state {
	BLE_RESOURCE_STATE_IDLE = 0,
	BLE_RESOURCE_STATE_ERASING,
	BLE_RESOURCE_STATE_RECEIVING,
	BLE_RESOURCE_STATE_READY,
	BLE_RESOURCE_STATE_COMMITTED,
	BLE_RESOURCE_STATE_ERROR,
};

struct ble_resource_status {
	uint8_t  state;
	int8_t   error;
	uint32_t received;
	uint32_t total;
	uint32_t active_version; /* partition header.version of active slot */
	uint8_t  active_slot;
} __packed;

void ble_resource_transfer_reset(void);

#ifdef __cplusplus
}
#endif

#endif /* BLE_RESOURCE_TRANSFER_H */
```

## include/cloud_telemetry.h
```c
/*
 * SPDX-License-Identifier: Apache-2.0
 *
 * Cloud telemetry — MQTT publish of measurement results when Wi-Fi is up.
 * Broker settings come from config.json (cloud section).
 */

#ifndef CLOUD_TELEMETRY_H_
#define CLOUD_TELEMETRY_H_

#include <stdint.h>

struct ble_vitals_data;
struct ble_glucose_data;
struct ble_wifi_status;

#ifdef __cplusplus
extern "C" {
#endif

/**
 * @brief Initialize cloud telemetry (MQTT client + work items).
 * @return 0 on success, negative errno on failure
 */
int cloud_telemetry_init(void);

/**
 * @brief React to Wi-Fi status changes (connect / disconnect).
 * Schedules MQTT connect after a short delay when connected.
 */
void cloud_telemetry_on_wifi_status(const struct ble_wifi_status *status);

/**
 * @brief Queue vitals JSON publish to MQTT (non-blocking).
 */
void cloud_telemetry_publish_vitals(const struct ble_vitals_data *data);

/**
 * @brief Queue glucose JSON publish to MQTT (non-blocking).
 */
void cloud_telemetry_publish_glucose(const struct ble_glucose_data *data);

#ifdef __cplusplus
}
#endif

#endif /* CLOUD_TELEMETRY_H_ */
```

## include/device_identity.h
```c
/**
 * @file device_identity.h
 * @brief nRF hardware device ID as uppercase hex (first 8 bytes)
 */

#ifndef DEVICE_IDENTITY_H_
#define DEVICE_IDENTITY_H_

#include <stddef.h>
#include <stdint.h>

/**
 * @brief Format hwinfo device ID into buf (uppercase hex, no separators).
 *
 * @return Number of hex characters written (excluding NUL), or negative errno.
 */
int device_identity_get_hex(char *buf, size_t len);

/**
 * @brief Low 32 bits of the hwinfo device ID (little-endian), 0 if unavailable.
 */
uint32_t device_identity_get_u32(void);

#endif /* DEVICE_IDENTITY_H_ */
```
